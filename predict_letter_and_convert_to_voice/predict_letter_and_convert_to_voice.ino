#include <Wire.h>
#include <SoftwareSerial.h>
#include <Adafruit_Sensor.h>
#include <Adafruit_MPU6050.h>
#include <math.h>

Adafruit_MPU6050 mpu;

SoftwareSerial BTSerial(10, 11); 

const int flexsensor0 = A0;
const int flexsensor1 = A1;
const int flexsensor2 = A2;
const int flexsensor3 = A3;
const int flexsensor4 = A6;

int val0, val1, val2, val3, val4;

float angle_x_acc, angle_y_acc, angle_z_gyro;
float gyro_offset_z = 0.0;

const float rAD_TO_DEG = 180.0 / PI;
const float DT = 0.01;

// Trained model's weights and biases
float W1[50][8] = {
  {0.231, -0.549,  0.456, -0.123,  0.672,  0.342, -0.975,  0.231},
  {-0.832,  0.547, -0.346,  0.764, -0.645,  0.230,  0.798, -0.517},
  {0.202,  0.315, -0.523,  0.942, -0.184, -0.259,  0.609, -0.758},
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  {-0.275,  0.091, -0.642, -0.510,  0.521,  0.701, -0.397, -0.671}
};

float b1[50] = {
  0.405, -0.643, 0.727, 0.162, -0.384, 0.062, -0.195, 0.312, -0.019, -0.508, 
  -0.789, 0.268, -0.332, 0.412, 0.681, -0.289, 0.022, -0.157, -0.325, 0.713, 
  0.229, -0.512, 0.169, -0.641, 0.831, 0.241, -0.689, -0.578, -0.128, 0.034, 
  -0.273, 0.235, 0.196, 0.612, 0.789, 0.417, -0.232, -0.297, 0.531, 0.075, 
  0.285, 0.268, 0.052, -0.313, -0.124, 0.533, -0.028, 0.374, 0.496, -0.262
};


float W2[26][50] = {
  {0.517, -.549, -0.271, -0.629, -0.258,  0.213, -0.759,  0.426, -0.051},
  {0.841, -0.117, -0.472,  0.431, -0.725,  0.852, -0.724, -0.211},
  {-0.198,  0.435,  0.097,  0.671, -0.876, -0.204,  0.278, -0.599},
  {0.633,  0.560, -0.507, -0.743,  0.754,  0.180,  0.612,  0.085},
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  {-0.298, -0.279,  0.415,  0.689, -0.115,  0.717, -0.827, -0.564}
};

float b2[26] = {
  -0.395,  0.547, -0.626,  0.228, -0.189, -0.478, -0.066,  0.323,  0.167, 0.202,
  -0.577, -0.176,  0.562,  0.302,  0.406, -0.492, -0.370,  0.351,  0.642, -0.480,
  0.341, -0.225,  0.341,  0.152,  0.436, -0.199,  0.348,  0.095
};


// Softmax Function
float* softmax(float Z[], int n) {
  float max_z = Z[0];
  for (int i = 1; i < n; ++i) {
    if (Z[i] > max_z) max_z = Z[i];
  }

  float sum = 0.0;
  for (int i = 0; i < n; ++i) {
    Z[i] = exp(Z[i] - max_z);
    sum += Z[i];
  }

  for (int i = 0; i < n; ++i) {
    Z[i] /= sum;
  }

  return Z;
}

void setup() {
  Serial.begin(9600);

  if (!mpu.begin()) {
    Serial.println("Failed to find MPU6050 chip");
    while (1) delay(10);
  }

  Serial.println("MPU6050 Initialized");

  mpu.setAccelerometerRange(MPU6050_RANGE_2_G);
  mpu.setGyroRange(MPU6050_RANGE_250_DEG);
  mpu.setFilterBandwidth(MPU6050_BAND_21_HZ);

  delay(100);

  BTSerial.begin(9600);

  // Calibrate gyroscope offset for Z-axis
  for (int i = 0; i < 100; ++i) {
    sensors_event_t a, g, temp;
    mpu.getEvent(&a, &g, &temp);
    gyro_offset_z += g.gyro.z;
    delay(10);
  }
  gyro_offset_z /= 100.0;

  // Initialize random weights and biases
  randomSeed(analogRead(0)); // Seed the random number generator

  for (int i = 0; i < 50; i++) {
    for (int j = 0; j < 8; j++) {
      W1[i][j] = random(-1000, 1000) / 1000.0; // Randomized weight values
    }
    b1[i] = random(-1000, 1000) / 1000.0; // Randomized bias values
  }

  for (int i = 0; i < 26; i++) {
    for (int j = 0; j < 50; j++) {
      W2[i][j] = random(-1000, 1000) / 1000.0; // Randomized weight values
    }
    b2[i] = random(-1000, 1000) / 1000.0; // Randomized bias values
  }
}

void loop() {
  // Read flex sensor values
  val0 = analogRead(flexsensor0);
  val1 = analogRead(flexsensor1);
  val2 = analogRead(flexsensor2);
  val3 = analogRead(flexsensor3);
  val4 = analogRead(flexsensor4);

  // Get MPU6050 data
  sensors_event_t a, g, temp;
  mpu.getEvent(&a, &g, &temp);

  // Calculate angles from accelerometer
  angle_x_acc = atan2(a.acceleration.y, sqrt(a.acceleration.x * a.acceleration.x + a.acceleration.z * a.acceleration.z)) * rAD_TO_DEG;
  angle_y_acc = atan2(-a.acceleration.x, sqrt(a.acceleration.y * a.acceleration.y + a.acceleration.z * a.acceleration.z)) * rAD_TO_DEG;

  // Normalize accelerometer angles
  angle_x_acc = fmod(angle_x_acc, 360.0);
  if (angle_x_acc < 0) angle_x_acc += 360.0;

  angle_y_acc = fmod(angle_y_acc, 360.0);
  if (angle_y_acc < 0) angle_y_acc += 360.0;

  // Calculate gyroscope angle for Z-axis
  angle_z_gyro = (g.gyro.z - gyro_offset_z) * DT;

  // Normalize gyroscope angle
  angle_z_gyro = fmod(angle_z_gyro, 360.0);
  if (angle_z_gyro < 0) angle_z_gyro += 360.0;

  // Prepare input for the neural network (normalizing the values)
  float X[8] = {val0 / 1023.0, val1 / 1023.0, val2 / 1023.0, val3 / 1023.0, val4 / 1023.0,
                angle_x_acc / 360.0, angle_y_acc / 360.0, angle_z_gyro / 360.0};

  // Forward propagation
  float Z1[50];
  for (int i = 0; i < 50; i++) {
    Z1[i] = b1[i];
    for (int j = 0; j < 8; j++) {
      Z1[i] += W1[i][j] * X[j];
    }
  }

  // Apply ReLU activation
  float A1[50];
  for (int i = 0; i < 50; i++) {
    A1[i] = fmax(0, Z1[i]);  
  }

  // Output layer
  float Z2[26];
  for (int i = 0; i < 26; i++) {
    Z2[i] = b2[i];
    for (int j = 0; j < 50; j++) {
      Z2[i] += W2[i][j] * A1[j];
    }
  }

  // Apply softmax
  float* output = softmax(Z2, 26);

  // Find the predicted class (letter)
  int predicted_class = 0;
  float max_output = output[0];
  for (int i = 1; i < 26; i++) {
    if (output[i] > max_output) {
      max_output = output[i];
      predicted_class = i;
    }
  }

  char predicted_letter = 'A' + predicted_class; 
  Serial.println(predicted_letter);
  BTSerial.println(predicted_letter);

  delay(1000);
}
